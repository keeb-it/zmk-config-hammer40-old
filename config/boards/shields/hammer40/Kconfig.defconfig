## config/boards/shields/hammer40/Kconfig.defconfig
```kconfig
if SHIELD_HAMMER40

config ZMK_KEYBOARD_NAME
  default "hammer40"

endif

if ZMK_DISPLAY

config I2C
  default y

config SSD1306
  default y

config SSD1306_REVERSE_MODE
  default y

endif # ZMK_DISPLAY
```
